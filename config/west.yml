## config/west.yml
```yaml
manifest:
  remotes:
    - name: xand3r40r93
      url-base: https://github.com/xand3r40r93
  projects:
    - name: zmk
      remote: xand3r40r93
      revision: v1.0.0
      import: app/west.yml
  self:
    path: config
```
