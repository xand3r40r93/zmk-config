#define MOUSE_MOVE_SPEED 1500
#define MOUSE_MOVE_SPEED2 5000
#define MOUSE_MOVE_TIME 1000
#define MOUSE_MOVE_EXPONENT 1

#define MOUSE_SCROLL_SPEED 25
#define MOUSE_SCROLL_TIME 2000
#define MOUSE_SCROLL_EXPONENT 1

&mmv {
  time-to-max-speed-ms = <MOUSE_MOVE_TIME>;
  acceleration-exponent = <MOUSE_MOVE_EXPONENT>;
};

&mwh {
  time-to-max-speed-ms = <MOUSE_SCROLL_TIME>;
  acceleration-exponent=<MOUSE_SCROLL_EXPONENT>;
};

#undef MOVE_UP
#undef MOVE_DOWN
#undef MOVE_LEFT
#undef MOVE_RIGHT
#define MOVE_UP MOVE_VERT(-MOUSE_MOVE_SPEED)
#define MOVE_DOWN MOVE_VERT(MOUSE_MOVE_SPEED)
#define MOVE_LEFT MOVE_HOR(-MOUSE_MOVE_SPEED)
#define MOVE_RIGHT MOVE_HOR(MOUSE_MOVE_SPEED)

#undef SCROLL_UP
#undef SCROLL_DOWN
#undef SCROLL_LEFT
#undef SCROLL_RIGHT
#define SCROLL_UP SCROLL_VERT(MOUSE_SCROLL_SPEED)
#define SCROLL_DOWN SCROLL_VERT(-MOUSE_SCROLL_SPEED)
#define SCROLL_LEFT SCROLL_HOR(-MOUSE_SCROLL_SPEED)
#define SCROLL_RIGHT SCROLL_HOR(MOUSE_SCROLL_SPEED)

#define MMV_UP(speed) &mmv MOVE_VERT(-speed)
#define MMV_DOWN(speed) &mmv MOVE_VERT(speed)
#define MMV_LEFT(speed) &mmv MOVE_HOR(-speed)
#define MMV_RIGHT(speed) &mmv MOVE_HOR(speed)

/ {
  behaviors {
    MOD_MORPH(mmv_up, MMV_UP(MOUSE_MOVE_SPEED), MMV_UP(MOUSE_MOVE_SPEED2), mods = <(MOD_LALT)>;)
    MOD_MORPH(mmv_down, MMV_DOWN(MOUSE_MOVE_SPEED), MMV_DOWN(MOUSE_MOVE_SPEED2), mods = <(MOD_LALT)>;)
    MOD_MORPH(mmv_left, MMV_LEFT(MOUSE_MOVE_SPEED), MMV_LEFT(MOUSE_MOVE_SPEED2), mods = <(MOD_LALT)>;)
    MOD_MORPH(mmv_right, MMV_RIGHT(MOUSE_MOVE_SPEED), MMV_RIGHT(MOUSE_MOVE_SPEED2), mods = <(MOD_LALT)>;)
  };
};
