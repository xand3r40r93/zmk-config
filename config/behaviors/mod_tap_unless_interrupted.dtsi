// &mt {
//   tapping-term-ms = <150>;
// };

/ {
  behaviors {
    mt_ui: mod_tap_unless_interrupted {
      compatible = "zmk,behavior-hold-tap";
      label = "MOD_TAP_UNLESS_INTERRUPTED";
      #binding-cells = <2>;
      flavor = "tap-unless-interrupted";
      tapping-term-ms = <200>;
      quick-tap-ms = <200>;
      bindings = <&kp>, <&kp>;
    };
  };
};
