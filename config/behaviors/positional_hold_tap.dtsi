/ {
  behaviors {
    lh_pht: left_hand_positional_hold_tap {
      compatible = "zmk,behavior-hold-tap";
      label = "LEFT_POSITIONAL_HOLD_TAP";
      #binding-cells = <2>;
      flavor = "tap-unless-interrupted";
      tapping-term-ms = <100>; // <---[[produces tap if held longer than tapping-term-ms]]
      quick-tap-ms = <200>;
      bindings = <&kp>, <&kp>;
      hold-trigger-key-positions = <6 7 8 9 10 11  18 19 20 21 22 23  30 31 32 33 34 35  39 40 41>; // <---[[right-hand keys]]
    };
    rh_pht: right_hand_positional_hold_tap {
      compatible = "zmk,behavior-hold-tap";
      label = "RIGHT_POSITIONAL_HOLD_TAP";
      #binding-cells = <2>;
      flavor = "tap-unless-interrupted";
      tapping-term-ms = <100>; // <---[[produces tap if held longer than tapping-term-ms]]
      quick-tap-ms = <200>;
      bindings = <&kp>, <&kp>;
      hold-trigger-key-positions = <0 1 2 3 4 5  12 13 14 15 16 17  24 25 26 27 28 29  36 37 38>; // <---[[left-hand keys]]
    };
  };
};
